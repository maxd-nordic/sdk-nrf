## CMakeLists.txt
```
#
# Copyright (c) 2025 Nordic Semiconductor
#
# SPDX-License-Identifier: LicenseRef-Nordic-5-Clause
#

cmake_minimum_required(VERSION 3.20.0)

find_package(Zephyr REQUIRED HINTS $ENV{ZEPHYR_BASE})
project(app_jwt_test)


FILE(GLOB app_sources src/*.c)
target_sources(app PRIVATE ${app_sources})

target_sources(app
  PRIVATE
  ${ZEPHYR_NRF_MODULE_DIR}/lib/app_jwt/app_jwt.c
  )

target_include_directories(app
  PRIVATE
  ./include/
  ${ZEPHYR_NRF_MODULE_DIR}/subsys/net/lib/nrf_cloud/include/
  ${ZEPHYR_NRF_MODULE_DIR}/../modules/crypto/tinycrypt/lib/include/
  )

target_compile_options(app
  PRIVATE
  -DCONFIG_APP_JWT_LOG_LEVEL=4
  -DCONFIG_APP_JWT_DEFAULT_TIMESTAMP=1735682400
  )
```

## prj.conf
```kconfig
#
# Copyright (c) 2025 Nordic Semiconductor
#
# SPDX-License-Identifier: LicenseRef-Nordic-5-Clause
#
CONFIG_ZTEST=y

CONFIG_MAIN_STACK_SIZE=4096
CONFIG_CJSON_LIB=y
CONFIG_NEWLIB_LIBC=y
CONFIG_NEWLIB_LIBC_FLOAT_PRINTF=y
CONFIG_HEAP_MEM_POOL_SIZE=4096
```

## src/main.c
```c
/*
 * Copyright (c) 2025 Nordic Semiconductor ASA
 * SPDX-License-Identifier: LicenseRef-Nordic-5-Clause
 */

#include <string.h>
#include <stdint.h>
#include <zephyr/kernel.h>
#include <zephyr/ztest.h>

#include <net/nrf_cloud.h>
#include <zephyr/fff.h>

DEFINE_FFF_GLOBALS;

FAKE_VOID_FUNC(nrf_cloud_free, void *);
FAKE_VALUE_FUNC(sec_tag_t, nrf_cloud_sec_tag_get);
FAKE_VALUE_FUNC(int, nrf_cloud_client_id_ptr_get, const char **);
FAKE_VALUE_FUNC(int, date_time_now, int64_t *);
FAKE_VALUE_FUNC(void *, nrf_cloud_calloc, size_t, size_t);
FAKE_VALUE_FUNC(int, tls_credential_get, sec_tag_t, enum tls_credential_type, void *, size_t *);
FAKE_VALUE_FUNC(int, base64_encode, uint8_t *, size_t, size_t *, const uint8_t *, size_t);
FAKE_VALUE_FUNC(int, base64_decode, uint8_t *, size_t, size_t *, const uint8_t *, size_t);

ZTEST(jwt_app_test, test_1)
{
	uint8_t buf[1024];
	int err = nrf_cloud_jwt_generate(0, buf, sizeof(buf));

	zassert_equal(err, 0, "err: %d", err);
}

static void *setup(void)
{
	/* reset fakes */
	RESET_FAKE(nrf_cloud_free);
	RESET_FAKE(nrf_cloud_sec_tag_get);
	RESET_FAKE(nrf_cloud_client_id_ptr_get);
	RESET_FAKE(date_time_now);
	RESET_FAKE(nrf_cloud_calloc);
	RESET_FAKE(tls_credential_get);
	RESET_FAKE(base64_encode);
	RESET_FAKE(base64_decode);
	return NULL;
}

static void teardown(void *unit)
{
	(void)unit;
}

ZTEST_SUITE(jwt_app_test, NULL, setup, teardown, NULL, NULL);
```

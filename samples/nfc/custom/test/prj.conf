## CMakeLists.txt
```
cmake_minimum_required(VERSION 3.20.0)

find_package(Zephyr REQUIRED HINTS $ENV{ZEPHYR_BASE})
project(test)

FILE(GLOB app_sources src/*.c)
target_sources(app PRIVATE ${app_sources})

test_runner_generate(src/main.c)

target_sources(app
  PRIVATE
  ../src/crypto.c
)

zephyr_include_directories(../src)
zephyr_include_directories(${ZEPHYR_BASE}/subsys/testsuite/include)
```

## prj.conf
```kconfig
CONFIG_UNITY=y
```

## src/main.c
```c
#include <unity.h>
#include <stdbool.h>
#include <stdlib.h>
#include <string.h>
#include <zephyr/kernel.h>

#include <zephyr/fff.h>

DEFINE_FFF_GLOBALS;

void setUp(void)
{}

void tearDown(void)
{}

void test_mutual0(void)
{
	TEST_ASSERT(false);
}


extern int unity_main(void);

void main(void)
{
	/* use the runner from test_runner_generate() */
	(void)unity_main();
}
```

## CMakeLists.txt
```
# SPDX-License-Identifier: Apache-2.0

cmake_minimum_required(VERSION 3.20.0)

find_package(Zephyr REQUIRED HINTS $ENV{ZEPHYR_BASE})
project(hello_world)

target_sources(app PRIVATE src/main.c)

target_sources_ifdef(CONFIG_SIMPLE_CONFIG app PRIVATE lib/simple_config.c)


target_include_directories(app PRIVATE lib)
```

## Kconfig
```
#
# Copyright (c) 2023 Nordic Semiconductor ASA
#
# SPDX-License-Identifier: LicenseRef-Nordic-5-Clause
#

menu "Zephyr Kernel"
source "Kconfig.zephyr"
endmenu

module = APP
module-str = app
source "subsys/logging/Kconfig.template.log_config"

rsource "lib/Kconfig.simple_config"
```

## prj.conf
```kconfig
CONFIG_NCS_SAMPLES_DEFAULTS=y

CONFIG_RESET_ON_FATAL_ERROR=n
# Improved Logging
# CONFIG_LOG_MODE_DEFERRED allows logging from multiple threads simultaneously without creating
# splintered log entries, at the cost of needing a buffer for storing logs.
CONFIG_LOG=y
CONFIG_LOG_MODE_DEFERRED=y

# CONFIG_LOG_BUFFER_SIZE is the aforementioned buffer. A size of 4096 bytes is useful for debugging
# and prototyping, but is probably more than necessary for production-ready firmware.
CONFIG_LOG_BUFFER_SIZE=4096

# Heap and stacks
# Extended AT host/monitor stack/heap sizes since some nrf_cloud credentials are longer than 1024 bytes.
CONFIG_AT_MONITOR_HEAP_SIZE=2048
CONFIG_AT_HOST_STACK_SIZE=2048
# Extended memory heap size needed both for PGPS and for encoding JSON-based nRF Cloud Device Messages.
CONFIG_HEAP_MEM_POOL_SIZE=24576
CONFIG_SYSTEM_WORKQUEUE_STACK_SIZE=4096

# Enable Networking and Connection Manager.
CONFIG_NETWORKING=y
CONFIG_NET_SOCKETS=y
CONFIG_NET_SOCKETS_OFFLOAD=y
CONFIG_NET_MGMT_EVENT_STACK_SIZE=2048
CONFIG_NET_CONNECTION_MANAGER_MONITOR_STACK_SIZE=1024
CONFIG_MAIN_STACK_SIZE=2048

# Enable LTE Connectivity using Connection Manager
CONFIG_NET_IPV4=y
CONFIG_NET_IPV6=y
CONFIG_NET_IPV6_NBR_CACHE=n
CONFIG_NET_IPV6_MLD=n
CONFIG_NET_CONNECTION_MANAGER=y
CONFIG_NRF_MODEM_LIB_ON_FAULT_APPLICATION_SPECIFIC=y
CONFIG_NRF_MODEM_LIB_NET_IF=y
CONFIG_NRF_MODEM_LIB_NET_IF_AUTO_DOWN=y
CONFIG_NRF_MODEM_LIB_NET_IF_DOWN_DEFAULT_LTE_DISCONNECT=y

# Enable power savings mode
CONFIG_LTE_PSM_REQ=y
# Set the PSM Requested Active Time to 20 seconds
CONFIG_LTE_PSM_REQ_RAT="00001010"

# Modem library
CONFIG_NRF_MODEM_LIB=y

# AT commands interface
CONFIG_UART_INTERRUPT_DRIVEN=y
CONFIG_AT_HOST_LIBRARY=y

# nRF Cloud
CONFIG_MQTT_KEEPALIVE=120
CONFIG_NRF_CLOUD_MQTT=n # This also enables FOTA by implicitly setting CONFIG_NRF_CLOUD_FOTA=y
CONFIG_NRF_CLOUD_COAP=y
CONFIG_MODEM_JWT=y

# On initial connection to the cloud, add info sections to the shadow
CONFIG_NRF_CLOUD_SEND_DEVICE_STATUS=y
CONFIG_NRF_CLOUD_SEND_DEVICE_STATUS_NETWORK=y
CONFIG_NRF_CLOUD_SEND_DEVICE_STATUS_SIM=y
CONFIG_NRF_CLOUD_SEND_SERVICE_INFO_FOTA=y
CONFIG_NRF_CLOUD_SEND_SERVICE_INFO_UI=y

# MCUBOOT - Needed by FOTA
CONFIG_BOOTLOADER_MCUBOOT=y
CONFIG_IMG_MANAGER=y
CONFIG_MCUBOOT_IMG_MANAGER=y
CONFIG_STREAM_FLASH_ERASE=y

# Date Time lib - Used by PGPS and main application
CONFIG_DATE_TIME=y

CONFIG_SETTINGS=y
CONFIG_SETTINGS_FCB=y
CONFIG_FCB=y

# Download Client - used by FOTA and PGPS
CONFIG_DOWNLOAD_CLIENT=y
CONFIG_DOWNLOAD_CLIENT_HTTP_FRAG_SIZE_1024=y
CONFIG_DOWNLOAD_CLIENT_STACK_SIZE=4096
CONFIG_DOWNLOAD_CLIENT_BUF_SIZE=2300
CONFIG_DOWNLOAD_CLIENT_MAX_HOSTNAME_SIZE=128

# Flash - Used by FOTA and PGPS
CONFIG_FLASH=y
CONFIG_FLASH_PAGE_LAYOUT=y
CONFIG_FLASH_MAP=y
CONFIG_STREAM_FLASH=y
CONFIG_MPU_ALLOW_FLASH_WRITE=y
CONFIG_NRF_CLOUD_ALERT=y
CONFIG_NRF_CLOUD_LOG_DIRECT=y
CONFIG_NRF_CLOUD_LOG_OUTPUT_LEVEL=3

# These options are required because the defaults will result in errors (cool..)
CONFIG_COAP_CLIENT_THREAD_PRIORITY=0
CONFIG_COAP_CLIENT_BLOCK_SIZE=1024
CONFIG_COAP_CLIENT_MESSAGE_SIZE=1024
CONFIG_COAP_CLIENT_STACK_SIZE=6144
CONFIG_COAP_EXTENDED_OPTIONS_LEN_VALUE=40

CONFIG_SIMPLE_CONFIG=y
CONFIG_DK_LIBRARY=y


CONFIG_COAP_LOG_LEVEL_DBG=y
CONFIG_SIMPLE_CONFIG_LOG_LEVEL_DBG=y
CONFIG_APP_LOG_LEVEL_DBG=y

CONFIG_ASSERT=y
CONFIG_REBOOT=y

# needed for processing floats
CONFIG_PICOLIBC=y
CONFIG_FPU=y
```

## src/main.c
```c
/*
 * Copyright (c) 2024 Nordic Semiconductor ASA
 *
 * SPDX-License-Identifier: LicenseRef-Nordic-5-Clause
 */

#include <stdio.h>
#include <zephyr/kernel.h>
#include <zephyr/logging/log.h>
#include <zephyr/logging/log_ctrl.h>
#include <zephyr/net/conn_mgr_connectivity.h>
#include <zephyr/net/conn_mgr_monitor.h>
#include <date_time.h>
#include <net/nrf_cloud.h>
#include <net/nrf_cloud_coap.h>
#include <modem/modem_info.h>
#include <zephyr/sys/reboot.h>

#include <dk_buttons_and_leds.h>

#include "simple_config.h"

/* Register log module */
LOG_MODULE_REGISTER(app, CONFIG_APP_LOG_LEVEL);


/* Macros used to subscribe to specific Zephyr NET management events. */
#define L4_EVENT_MASK (NET_EVENT_L4_CONNECTED | NET_EVENT_L4_DISCONNECTED)
#define CONN_LAYER_EVENT_MASK (NET_EVENT_CONN_IF_FATAL_ERROR)

#define SEND_FATAL_ERROR() \
		LOG_ERR("fatal error");	\
		LOG_PANIC();									\
		IF_ENABLED(CONFIG_REBOOT, (sys_reboot(0)));

K_SEM_DEFINE(date_time_ready_sem, 0, 1);
K_SEM_DEFINE(connected_sem, 0, 1);

/* Zephyr NET management event callback structures. */
static struct net_mgmt_event_callback l4_cb;
static struct net_mgmt_event_callback conn_cb;

static void l4_event_handler(struct net_mgmt_event_callback *cb,
			     uint32_t event,
			     struct net_if *iface)
{
	switch (event) {
	case NET_EVENT_L4_CONNECTED:
		LOG_INF("Network connectivity established");
		if (k_sem_count_get(&date_time_ready_sem) == 1) {
			LOG_INF("reconnecting to cloud service");
			nrf_cloud_coap_connect(NULL);
		}
		k_sem_give(&connected_sem);
		break;
	case NET_EVENT_L4_DISCONNECTED:
		LOG_INF("Network connectivity lost");
		nrf_cloud_coap_disconnect();
		break;
	default:
		/* Don't care */
		return;
	}
}

static void connectivity_event_handler(struct net_mgmt_event_callback *cb,
				       uint32_t event,
				       struct net_if *iface)
{
	if (event == NET_EVENT_CONN_IF_FATAL_ERROR) {
		LOG_ERR("NET_EVENT_CONN_IF_FATAL_ERROR");
		SEND_FATAL_ERROR();
		return;
	}
}

static void date_time_handler(const struct date_time_evt *evt) {
	if (evt->type != DATE_TIME_NOT_OBTAINED) {
		LOG_INF("time aquired");
		k_sem_give(&date_time_ready_sem);
	}
}

static void network_task(void)
{
	int err;

	/* Setup handler for Zephyr NET Connection Manager events. */
	net_mgmt_init_event_callback(&l4_cb, l4_event_handler, L4_EVENT_MASK);
	net_mgmt_add_event_callback(&l4_cb);

	/* Setup handler for Zephyr NET Connection Manager Connectivity layer. */
	net_mgmt_init_event_callback(&conn_cb, connectivity_event_handler, CONN_LAYER_EVENT_MASK);
	net_mgmt_add_event_callback(&conn_cb);

	/* Setup handler for date_time library */
	date_time_register_handler(date_time_handler);

	/* Connecting to the configured connectivity layer.
	 * Wi-Fi or LTE depending on the board that the sample was built for.
	 */
	LOG_INF("Bringing network interface up and connecting to the network");

	err = conn_mgr_all_if_up(true);
	if (err) {
		LOG_ERR("conn_mgr_all_if_up, error: %d", err);
		SEND_FATAL_ERROR();
		return;
	}

	err = conn_mgr_all_if_connect(true);
	if (err) {
		LOG_ERR("conn_mgr_all_if_connect, error: %d", err);
		SEND_FATAL_ERROR();
		return;
	}

	/* Resend connection status if the sample is built for Native Posix.
	 * This is necessary because the network interface is automatically brought up
	 * at SYS_INIT() before main() is called.
	 * This means that NET_EVENT_L4_CONNECTED fires before the
	 * appropriate handler l4_event_handler() is registered.
	 */
	if (IS_ENABLED(CONFIG_BOARD_NATIVE_POSIX)) {
		conn_mgr_mon_resend_status();
	}
}

K_THREAD_DEFINE(network_task_id,
		1024,
		network_task, NULL, NULL, NULL, K_LOWEST_APPLICATION_THREAD_PRIO , 0, 0);


int config_cb(const char *key, const struct simple_config_val *val)
{
	if (val->type == SIMPLE_CONFIG_VAL_STRING) {
		LOG_DBG("key: %s, val: %s", key, val->val._str);
	} else if (val->type == SIMPLE_CONFIG_VAL_BOOL) {
		LOG_DBG("key: %s, val: %s", key, val->val._bool ? "true" : "false");
	} else if (val->type == SIMPLE_CONFIG_VAL_DOUBLE) {
		LOG_DBG("key: %s, val: %f", key, val->val._double);
	} else {
		return -EINVAL;
	}

	if (strcmp(key, "led_red") == 0) {
		if (val->type != SIMPLE_CONFIG_VAL_BOOL) {
			LOG_ERR("invalid type");
			return -EINVAL;
		}
		if (val->val._bool) {
			dk_set_led_on(DK_LED1);
		} else {
			dk_set_led_off(DK_LED1);
		}
		return 0;
	}

	return -EINVAL;
}

int main(void)
{
	int err = nrf_cloud_coap_init();
	if (err)
	{
		LOG_ERR("nrf_cloud_coap_init, error: %d", err);
		SEND_FATAL_ERROR();
	}
	LOG_INF("Hello World! %s", CONFIG_BOARD);

	simple_config_set_callback(config_cb);

	dk_leds_init();
	dk_set_led_on(DK_LED1);

	LOG_INF("waiting for network connectivity");
	k_sem_take(&connected_sem, K_FOREVER);
	k_sem_take(&date_time_ready_sem, K_FOREVER);

	LOG_INF("Connecting to cloud service");
	while (true)
	{
		err = nrf_cloud_coap_connect(NULL);
		if (err)
		{
			LOG_ERR("nrf_cloud_coap_connect, error: %d", err);
			k_sleep(K_SECONDS(1));
		}
		else
		{
			break;
		}
	}


	struct nrf_cloud_svc_info_ui ui_info = {
	    .gnss = true,
	};
	struct nrf_cloud_svc_info service_info = {
	    .ui = &ui_info};
	struct nrf_cloud_modem_info modem_info = {
	    .device = NRF_CLOUD_INFO_SET,
	    .network = NRF_CLOUD_INFO_SET,
	};
	struct nrf_cloud_device_status device_status = {
	    .modem = &modem_info,
	    .svc = &service_info};

	/* sending device info to shadow */
	err = nrf_cloud_coap_shadow_device_status_update(&device_status);
	if (err)
	{
		LOG_ERR("nrf_cloud_coap_shadow_device_status_update, error: %d", err);
		SEND_FATAL_ERROR();
	}

	err = simple_config_set("led_red", &(struct simple_config_val){.type = SIMPLE_CONFIG_VAL_BOOL, .val._bool = true});
	if (err)
	{
		LOG_ERR("simple_config_set, error: %d", err);
	}
	while (true) {
		simple_config_update();
		k_sleep(K_SECONDS(10));
	}

	return 0;
}
```

/* Copyright (c) 2024 Nordic Semiconductor ASA
 *
 * SPDX-License-Identifier: LicenseRef-Nordic-5-Clause
 */

#include <thingy91x_wifi.dtsi>

&accelerometer_lp {
	status = "okay";
};

&magnetometer {
	status = "okay";
};

&accelerometer_hp {
	status = "okay";
};

&bme680 {
	status = "okay";
};

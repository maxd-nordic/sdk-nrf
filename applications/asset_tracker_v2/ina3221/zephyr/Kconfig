## applications/asset_tracker_v2/ina3221/zephyr/Kconfig
```kconfig
#
# Copyright (c) 2022 Nordic Semiconductor ASA
#
# SPDX-License-Identifier: LicenseRef-Nordic-5-Clause
#

config INA3221_DRIVER
	bool "Support for the demonstration out of tree driver"

module = INA3221
module-str = INA3221 library
source "subsys/logging/Kconfig.template.log_config"
```

## applications/connectivity_bridge/boards/thingy91x_nrf5340_cpuapp.conf
```kconfig
CONFIG_BT_DEVICE_NAME="Thingy:91 X UART"


CONFIG_USB_MAX_NUM_TRANSFERS=8
CONFIG_USB_DEVICE_STACK=y
CONFIG_USB_DEVICE_BOS=y
CONFIG_USB_DEVICE_REMOTE_WAKEUP=n
CONFIG_USB_MAX_POWER=250
CONFIG_USB_DEVICE_PRODUCT="Thingy:91 X UART"
CONFIG_CMSIS_DAP_DEVICE_VENDOR="Nordic Semiconductor"
CONFIG_CMSIS_DAP_DEVICE_NAME="nrf9160_xxaa"
CONFIG_SERIAL=y
CONFIG_DAP=y

CONFIG_I2C=y
CONFIG_I2C_VIRTUAL_EEPROM_DRIVER=y
CONFIG_I2C_VIRTUAL_EEPROM_DRIVER_LOG_LEVEL_DBG=y
```

## boards/arm/thingy91v2_nrf5340/Kconfig.board
```kconfig
config BOARD_THINGY91V2_NRF5340_CPUAPP
	bool "nRF5340_APP THINGY91V2"
	depends on SOC_NRF5340_CPUAPP_QKAA

config BOARD_THINGY91V2_NRF5340_CPUAPP_NS
	bool "nRF5340_APP THINGY91V2"
	depends on SOC_NRF5340_CPUAPP_QKAA

config BOARD_THINGY91V2_NRF5340_CPUNET
	bool "nRF5340_NET THINGY91V2"
	depends on SOC_NRF5340_CPUNET_QKAA
```

## boards/arm/thingy91v2_nrf9161/Kconfig.board
```kconfig
# Thingy:91 nRF9161 board configuration
#
# Copyright (c) 2019 Nordic Semiconductor ASA
#
# SPDX-License-Identifier: LicenseRef-Nordic-5-Clause

if SOC_NRF9161_SICA

config BOARD_THINGY91V2_NRF9161
	bool "nRF9161 THINGY91V2"

config BOARD_THINGY91V2_NRF9161_NS
	bool "nRF9161 THINGY91V2 non-secure"

endif # SOC_NRF9161_SICA
```

## boards/arm/thingy91x_nrf5340/Kconfig.defconfig
```kconfig
# Thingy:91 X nRF5340 board configuration

# Copyright (c) 2024 Nordic Semiconductor
# SPDX-License-Identifier: LicenseRef-Nordic-5-Clause

if  BOARD_THINGY91X_NRF5340_CPUAPP || BOARD_THINGY91X_NRF5340_CPUAPP_NS

config BOARD
	default "thingy91x_nrf5340_cpuapp" if BOARD_THINGY91X_NRF5340_CPUAPP || BOARD_THINGY91X_NRF5340_CPUAPP_NS

DT_COMPAT_NORDIC_NRF700X_SPI := nordic,nrf700x-spi
config NRF7002_ON_SPI
	def_bool $(dt_compat_enabled,$(DT_COMPAT_NORDIC_NRF700X_SPI))

if NRF7002_ON_SPI

# For on-board regulators
config REGULATOR
	default y

# nPM6001 must be initialized after it is powered from nPM1300 (REGULATOR_NPM1300_INIT_PRIORITY)
config MFD_NPM6001_INIT_PRIORITY
	default 87
config REGULATOR_NPM6001_INIT_PRIORITY
	default 88
config WIFI_INIT_PRIORITY
	default 89

# GPIO hogs must be initialized after nPM1300 (GPIO_NPM1300_INIT_PRIORITY)
config GPIO_HOGS_INIT_PRIORITY
	default 86

endif # NRF7002_ON_SPI

# By default, if we build for a Non-Secure version of the board,
# enable building with TF-M as the Secure Execution Environment.
config BUILD_WITH_TFM
	default y if BOARD_THINGY91X_NRF5340_CPUAPP_NS

if BUILD_WITH_TFM

# By default, if we build with TF-M, instruct build system to
# flash the combined TF-M (Secure) & Zephyr (Non Secure) image
config TFM_FLASH_MERGED_BINARY
	bool
	default y

endif # BUILD_WITH_TFM

# Code Partition:
#
# For the secure version of the board the firmware is linked at the beginning
# of the flash, or into the code-partition defined in DT if it is intended to
# be loaded by MCUboot. If the secure firmware is to be combined with a non-
# secure image (TRUSTED_EXECUTION_SECURE=y), the secure FW image shall always
# be restricted to the size of its code partition.
#
# For the non-secure version of the board, the firmware
# must be linked into the code-partition (non-secure) defined in DT, regardless.
# Apply this configuration below by setting the Kconfig symbols used by
# the linker according to the information extracted from DT partitions.

# SRAM Partition:
#
# If the secure firmware is to be combined with a non-secure image
# (TRUSTED_EXECUTION_SECURE=y), the secure FW image SRAM shall always
# be restricted to the secure image SRAM partition (sram-secure-partition).
# Otherwise (if TRUSTED_EXECUTION_SECURE is not set) the whole zephyr,sram
# may be used by the image.
#
# For the non-secure version of the board, the firmware image SRAM is
# always restricted to the allocated non-secure SRAM partition.
#
# Workaround for not being able to have commas in macro arguments
DT_CHOSEN_Z_CODE_PARTITION := zephyr,code-partition
DT_CHOSEN_Z_SRAM_PARTITION := zephyr,sram-secure-partition

if BOARD_THINGY91X_NRF5340_CPUAPP && TRUSTED_EXECUTION_SECURE

config FLASH_LOAD_SIZE
	default $(dt_chosen_reg_size_hex,$(DT_CHOSEN_Z_CODE_PARTITION))

config SRAM_SIZE
	default $(dt_chosen_reg_size_int,$(DT_CHOSEN_Z_SRAM_PARTITION),0,K)

endif # BOARD_THINGY91X_NRF5340_CPUAPP && TRUSTED_EXECUTION_SECURE

config FLASH_LOAD_OFFSET
	default $(dt_chosen_reg_addr_hex,$(DT_CHOSEN_Z_CODE_PARTITION))

config FLASH_LOAD_SIZE
	default $(dt_chosen_reg_size_hex,$(DT_CHOSEN_Z_CODE_PARTITION))

choice BT_HCI_BUS_TYPE
	default BT_HCI_IPC if BT
endchoice

config HEAP_MEM_POOL_SIZE
	default 4096 if BT_HCI_IPC

endif # BOARD_THINGY91X_NRF5340_CPUAPP || BOARD_THINGY91X_NRF5340_CPUAPP_NS

config BOARD
	default "thingy91x_nrf5340_cpunet" if BOARD_THINGY91X_NRF5340_CPUNET

config MBOX_NRFX_IPC
	default MBOX

if BOARD_THINGY91X_NRF5340_CPUNET

config BT_CTLR
	default y if BT

endif # BOARD_THINGY91X_NRF5340_CPUNET

config USE_SEGGER_RTT
	default y if BOARD_THINGY91X_NRF5340_CPUAPP || BOARD_THINGY91X_NRF5340_CPUAPP_NS || BOARD_THINGY91X_NRF5340_CPUNET

config RTT_CONSOLE
	default y if BOARD_THINGY91X_NRF5340_CPUAPP || BOARD_THINGY91X_NRF5340_CPUAPP_NS || BOARD_THINGY91X_NRF5340_CPUNET

if !IS_BOOTLOADER_IMG

config SECURE_BOOT
	default y if BOARD_THINGY91X_NRF5340_CPUAPP || BOARD_THINGY91X_NRF5340_CPUAPP_NS || BOARD_THINGY91X_NRF5340_CPUNET

config BOOTLOADER_MCUBOOT
	default y if BOARD_THINGY91X_NRF5340_CPUAPP || BOARD_THINGY91X_NRF5340_CPUAPP_NS

config ADD_MCUBOOT_MEDIATE_SIM_FLASH_DTS
	default y if BOARD_THINGY91X_NRF5340_CPUAPP || BOARD_THINGY91X_NRF5340_CPUAPP_NS

config NRF53_UPGRADE_NETWORK_CORE
	default y if BOARD_THINGY91X_NRF5340_CPUAPP || BOARD_THINGY91X_NRF5340_CPUAPP_NS

config UPDATEABLE_IMAGE_NUMBER
	default 2 if BOARD_THINGY91X_NRF5340_CPUAPP || BOARD_THINGY91X_NRF5340_CPUAPP_NS

config SB_SIGNING_KEY_FILE
	default "$(ZEPHYR_NRF_MODULE_DIR)/boards/arm/thingy91x_nrf5340/nsib_signing_key.pem" if BOARD_THINGY91X_NRF5340_CPUAPP || BOARD_THINGY91X_NRF5340_CPUAPP_NS || BOARD_THINGY91X_NRF5340_CPUNET

endif # !IS_BOOTLOADER_IMG

if BOARD_SERIAL_BACKEND_CDC_ACM

config USB_DEVICE_PRODUCT
	default "Thingy:91 X Application"

config USB_DEVICE_VID
	default 0x1915

config USB_DEVICE_PID
	default 0x910A

config USB_DEVICE_STACK
	default y

config USB_CDC_ACM
	default y

config UART_CONSOLE
	default CONSOLE

config USB_DEVICE_INITIALIZE_AT_BOOT
	default y if !MCUBOOT

config SHELL_BACKEND_SERIAL_CHECK_DTR
	default SHELL
	depends on UART_LINE_CTRL

config UART_LINE_CTRL
	default SHELL

config USB_DEVICE_REMOTE_WAKEUP
	default n

config UART_INTERRUPT_DRIVEN
	default y

if LOG

# Logger cannot use itself to log
choice USB_CDC_ACM_LOG_LEVEL_CHOICE
	default USB_CDC_ACM_LOG_LEVEL_OFF
endchoice

# Set USB log level to error only
choice USB_DEVICE_LOG_LEVEL_CHOICE
	default USB_DEVICE_LOG_LEVEL_ERR
endchoice

# Wait 4000ms at startup for logging
config LOG_PROCESS_THREAD_STARTUP_DELAY_MS
	default 4000

endif # LOG

endif # BOARD_SERIAL_BACKEND_CDC_ACM
```

## boards/arm/thingy91x_nrf9151/Kconfig.board
```kconfig
# Thingy:91 X nRF9151 board configuration
#
# Copyright (c) 2023 Nordic Semiconductor ASA
#
# SPDX-License-Identifier: LicenseRef-Nordic-5-Clause

if SOC_NRF9151_LACA

config BOARD_THINGY91X_NRF9151
	bool "nRF9151 THINGY91X"

config BOARD_THINGY91X_NRF9151_NS
	bool "nRF9151 THINGY91X non-secure"

config THINGY91X_STATIC_PARTITIONS_FACTORY
	bool "Factory Thingy:91 X partition layout"
	help
	   The default Thingy:91 X partition layout used in the factory firmware. This ensures
	   firmware updates are compatible with Thingy:91 when flashing firmware over USB or over
	   the air.

endif # SOC_NRF9151_LACA
```

## boards/arm/thingy91x_nrf9161/Kconfig.board
```kconfig
# Thingy:91 X nRF9161 board configuration
#
# Copyright (c) 2023 Nordic Semiconductor ASA
#
# SPDX-License-Identifier: LicenseRef-Nordic-5-Clause

if SOC_NRF9161_LACA

config BOARD_THINGY91X_NRF9161
	bool "nRF9161 THINGY91X"

config BOARD_THINGY91X_NRF9161_NS
	bool "nRF9161 THINGY91X non-secure"

endif # SOC_NRF9161_LACA
```

## dts/bindings/radio_coex/nordic,thingy91x-ble-coex.yaml
```yaml
# Copyright (c) 2024 Nordic Semiconductor
# SPDX-License-Identifier: LicenseRef-Nordic-5-Clause

description: |
    This is a representation of coexistence for the Thingy:91 X,
    where WiFi and LTE take precedence over BLE.
    Additionally, a RF_SR_EN signal has to be asserted whenever
    either BLE or WiFi use the radio.


compatible: "nordic,thingy91x-ble-coex"

include: base.yaml

properties:
    swctrl1-gpios:
        type: phandle-array
        required: true
        description: |
            Input GPIO of the SOC connected to nRF70, being asserted when it needs the 2.4G antenna.
    lte-coex2-gpios:
        type: phandle-array
        required: true
        description: |
            Input GPIO of the SOC connected to nrf91, being asserted when LTE is active on its antenna.
    rf-fe-sr-en-gpios:
        type: phandle-array
        required: true
        description: |
            Output GPIO of the SOC connected to the load switch powering the 2.4GHz RF switch.
```

## modules/bsec2/Kconfig
```kconfig
#
# Copyright (c) 2023 Nordic Semiconductor ASA
#
# SPDX-License-Identifier: LicenseRef-Nordic-5-Clause
#

config BSEC_LIB
	bool "Use Bosch BSEC library for BME68x"
	depends on !BME680
	help
	  Enable the use of Bosch BSEC library.
	  This configuration depends on the BME680 zephyr driver being disabled.

if BSEC_LIB

config BSEC_LIB_THREAD_STACK_SIZE
	int "BSEC thread stack size"
	default 4096

choice BSEC_LIB_SAMPLE_MODE
	prompt "Bosch BSEC sample mode"
	default BSEC_LIB_SAMPLE_MODE_LOW_POWER
	help
	  Configuration that sets how often sensor data is sampled from the BSEC library.
	  Each mode corresponds an internal preset that decides how often data is sampled from the
	  BME680.

config BSEC_LIB_SAMPLE_MODE_ULTRA_LOW_POWER
	bool "BSEC low ultra power mode"
	help
	  Sample data from BSEC every 0.0033333 Hz (300 second interval).

config BSEC_LIB_SAMPLE_MODE_LOW_POWER
	bool "BSEC low power mode"
	help
	  Sample data from BSEC every 0.33333 Hz (3 second interval).

config BSEC_LIB_SAMPLE_MODE_CONTINUOUS
	bool "BSEC continuous mode"
	help
	  Sample data from BSEC every 1 Hz (1 second interval).
	  This is a particularly power-hungry sample mode that should only be considered for
	  testing purposes.

endchoice # BSEC_LIB_SAMPLE_MODE

config BSEC_LIB_TEMPERATURE_OFFSET
	int "BSEC temperature offset in degree celsius * 100"
	default 200 if BOARD_THINGY91_NRF9160_NS
	default 100
	help
	  BSEC temperature offset. To account for external heat sources on the board.
	  The actual value is divided by 100. This is due to the Kconfig parser
	  not supporting floating point types.
	  The default value 200 is translated to 2.0 degrees celsius offset.

config BSEC_LIB_AMBIENT_TEMPERATURE
	int "BSEC ambient temperature in degree celsius * 100"
	default 2500
	help
	  BSEC ambient temperature. Used to estimate the heater resistance value in bme68x.

module = BSEC_LIB
module-str = BSEC Library
source "subsys/logging/Kconfig.template.log_config"

endif # BSEC_LIB
```

## samples/wifi/radio_test/boards/thingy91x_nrf9151_ns.conf
```kconfig
CONFIG_REGULATOR_SHELL=y
CONFIG_SENSOR_SHELL=y
CONFIG_AT_SHELL=y
CONFIG_FLASH_SHELL=y

# Increase RX ring buffer and command line buffer
# to enable writing of certificates from AT shell
CONFIG_SHELL_BACKEND_SERIAL_RX_RING_BUFFER_SIZE=8192
CONFIG_SHELL_CMD_BUFF_SIZE=3584
```

## samples/wifi/shell/boards/thingy91x_nrf5340_cpuapp.conf
```kconfig
CONFIG_SPI=y
CONFIG_FLASH=y
CONFIG_SPI_NOR=y
CONFIG_SPI_NOR_FLASH_LAYOUT_PAGE_SIZE=4096
CONFIG_SPI_NOR_SFDP_DEVICETREE=y
CONFIG_I2C=y
```

## CMakeLists.txt
```
#
# Copyright (c) 2022 Nordic Semiconductor ASA
#
# SPDX-License-Identifier: LicenseRef-Nordic-5-Clause
#

cmake_minimum_required(VERSION 3.20.0)

find_package(Zephyr REQUIRED HINTS $ENV{ZEPHYR_BASE})
project(gnss-eval)

target_sources(app PRIVATE src/main.c src/mqtt_helpers.c)
```

## Kconfig
```
#
# Copyright (c) 2022 Nordic Semiconductor ASA
#
# SPDX-License-Identifier: LicenseRef-Nordic-5-Clause
#

menu "GNSS evaluation sample"
config MQTT_TOPIC_PREFIX
	string "MQTT topic prefix"
	default "45adb858-13f4-11ed-882f-97c94111fe8a"

config MQTT_COMMAND_TOPIC
	string "MQTT command topic"
	default "command"

config MQTT_STATUS_TOPIC
	string "MQTT status topic"
	default "status"

config MQTT_DATA_TOPIC
	string "MQTT data topic"
	default "data"

config MQTT_CLIENT_ID
	string "MQTT Client ID"
	help
	  Use a custom Client ID string. If not set, the client ID will be
	  generated based on IMEI number (for nRF9160 based targets) or
	  randomly (for other platforms).
	default ""

config MQTT_BROKER_HOSTNAME
	string "MQTT broker hostname"
	default "test.mosquitto.org"

config MQTT_BROKER_PORT
	int "MQTT broker port"
	default 1883

config MQTT_MESSAGE_BUFFER_SIZE
	int "MQTT message buffer size"
	default 512

config MQTT_PAYLOAD_BUFFER_SIZE
	int "MQTT payload buffer size"
	default 512

config MQTT_RECONNECT_DELAY_S
	int "Seconds to delay before attempting to reconnect to the broker."
	default 60

config LTE_CONNECT_RETRY_DELAY_S
	int "Seconds to delay before attempting to retry LTE connection."
	default 120

config GNSS_TIMEOUT_S
	int "Seconds to delay before giving up on obtaining a fix."
	default 120

config WATCHDOG_TIMEOUT_S
	int "Seconds to wait for application to catch up before restarting"
	default 600
endmenu

config STOP_AFTER_FIRST_FIX
	bool "Stop measurement after getting the first fix"
	default false

config APP_LOW_POWER_MODE
	bool "Disable LEDs"
	default false

menu "Zephyr Kernel"
source "Kconfig.zephyr"
endmenu

module = GNSS_EVAL
module-str = GNSS Evaluation
source "${ZEPHYR_BASE}/subsys/logging/Kconfig.template.log_config"
```

## prj.conf
```kconfig
#
# Copyright (c) 2022 Nordic Semiconductor ASA
#
# SPDX-License-Identifier: LicenseRef-Nordic-5-Clause
#


# Networking
CONFIG_NETWORKING=y
CONFIG_NET_NATIVE=n
CONFIG_NET_SOCKETS_OFFLOAD=y
CONFIG_NET_SOCKETS=y
CONFIG_NET_SOCKETS_POSIX_NAMES=y

# LTE link control
CONFIG_LTE_LINK_CONTROL=y
CONFIG_LTE_AUTO_INIT_AND_CONNECT=n

# Modem library
CONFIG_NRF_MODEM_LIB=y

# MQTT
CONFIG_MQTT_LIB=y
CONFIG_MQTT_LIB_TLS=n
CONFIG_MQTT_CLEAN_SESSION=y

# Button support
CONFIG_DK_LIBRARY=y

# Enable logging
CONFIG_LOG=y

# Memory
CONFIG_MAIN_STACK_SIZE=4096
CONFIG_HEAP_MEM_POOL_SIZE=2048

# NewLib C
CONFIG_NEWLIB_LIBC=y
CONFIG_NEWLIB_LIBC_FLOAT_PRINTF=y
CONFIG_CBPRINTF_FP_SUPPORT=y

# Use DateTime to retrieve time once upon LTE connection
CONFIG_DATE_TIME=y
CONFIG_DATE_TIME_AUTO_UPDATE=y
CONFIG_DATE_TIME_UPDATE_INTERVAL_SECONDS=0
CONFIG_DATE_TIME_TOO_OLD_SECONDS=0
CONFIG_DATE_TIME_MODEM=y
CONFIG_DATE_TIME_NTP=y
CONFIG_LTE_NETWORK_MODE_LTE_M_NBIOT_GPS=y
CONFIG_AT_HOST_LIBRARY=y
CONFIG_AT_MONITOR_HEAP_SIZE=1024
CONFIG_UART_INTERRUPT_DRIVEN=y
# CONFIG_NRF_MODEM_LIB_TRACE_ENABLED=y

CONFIG_GNSS_TIMEOUT_S=120
CONFIG_WATCHDOG_TIMEOUT_S=600
CONFIG_MODEM_INFO=y
CONFIG_MODEM_INFO_ADD_BOARD=y
CONFIG_MODEM_INFO_ADD_NETWORK=y

CONFIG_WATCHDOG=y
CONFIG_APP_LOW_POWER_MODE=y
```

## prj_nrf9160dk_nrf9160_ns.conf
```kconfig
#
# Copyright (c) 2022 Nordic Semiconductor ASA
#
# SPDX-License-Identifier: LicenseRef-Nordic-5-Clause
#


# Networking
CONFIG_NETWORKING=y
CONFIG_NET_NATIVE=n
CONFIG_NET_SOCKETS_OFFLOAD=y
CONFIG_NET_SOCKETS=y
CONFIG_NET_SOCKETS_POSIX_NAMES=y

# LTE link control
CONFIG_LTE_LINK_CONTROL=y
CONFIG_LTE_AUTO_INIT_AND_CONNECT=n

# Modem library
CONFIG_NRF_MODEM_LIB=y

# MQTT
CONFIG_MQTT_LIB=y
CONFIG_MQTT_LIB_TLS=n
CONFIG_MQTT_CLEAN_SESSION=y

# Button support
CONFIG_DK_LIBRARY=y

# Enable logging
CONFIG_LOG=y

# Memory
CONFIG_MAIN_STACK_SIZE=4096
CONFIG_HEAP_MEM_POOL_SIZE=2048

# NewLib C
CONFIG_NEWLIB_LIBC=y
CONFIG_NEWLIB_LIBC_FLOAT_PRINTF=y
CONFIG_CBPRINTF_FP_SUPPORT=y

# Use DateTime to retrieve time once upon LTE connection
CONFIG_DATE_TIME=y
CONFIG_DATE_TIME_AUTO_UPDATE=y
CONFIG_DATE_TIME_UPDATE_INTERVAL_SECONDS=0
CONFIG_DATE_TIME_TOO_OLD_SECONDS=0
CONFIG_DATE_TIME_MODEM=y
CONFIG_DATE_TIME_NTP=y
CONFIG_NRF_MODEM_LIB_TRACE_ENABLED=y
CONFIG_LTE_NETWORK_MODE_LTE_M_NBIOT_GPS=y
```

## boards/thingy91_nrf9160_ns.overlay
```dts
/ {
        pwmleds {
                buzzer_pwm: buzzer_pwm {
			pwms = <&pwm1 0 PWM_MSEC(20) PWM_POLARITY_NORMAL>;
		};
        };
};
```

## src/main.c
```c
/*
 * Copyright (c) 2022 Nordic Semiconductor ASA
 *
 * SPDX-License-Identifier: LicenseRef-Nordic-5-Clause
 */
#include <zephyr/logging/log.h>
#include <zephyr/kernel.h>
#include <zephyr/device.h>
#include <zephyr/drivers/watchdog.h>
#include <stdio.h>

#include <nrf_modem_at.h>
#include <modem/lte_lc.h>
#include <date_time.h>
#include <nrf_modem_gnss.h>
#include <modem/modem_info.h>

#include "app.h"
#include "mqtt_helpers.h"

LOG_MODULE_REGISTER(gnss_eval, CONFIG_GNSS_EVAL_LOG_LEVEL);

/* The mqtt client struct */
static struct mqtt_client client;

/* date time semaphore */
static K_SEM_DEFINE(time_sem, 0, 1);

/* measure wait semaphore */
static K_SEM_DEFINE(measure_sem, 0, 1);

static struct nrf_modem_gnss_pvt_data_frame pvts[CONFIG_GNSS_TIMEOUT_S+1];
static size_t pvts_idx = 0;
static size_t pvts_send_idx = 0;

static uint32_t mqtt_connect_attempt;
static enum state_type state;

const struct device *wdt = DEVICE_DT_GET(DT_NODELABEL(wdt));
static int wdt_channel;

void set_state(enum state_type _state) {
	state = _state;
	if (_state == STATE_MEASURE){
		mqtt_connect_attempt = 0;
	}
}

static void button_handler(uint32_t button_states, uint32_t has_changed)
{
	if (has_changed & button_states & BIT(0)) {
		int ret;

		if (state == STATE_WAIT_FOR_COMMAND) {
			int64_t now_ms = 0; date_time_now(&now_ms);
			ret = _mqtt_command_publish(&client, now_ms/1000+30);
			if (ret) {
				LOG_ERR("command publish failed: %d", ret);
			}
		} else if (state == STATE_MEASURE_WAIT) {
			if(!k_sem_count_get(&measure_sem)) {
				k_sem_give(&measure_sem);
			}
		}
	}
}

bool test_modem_fw_ver(const char *should)
{
	int ret;
	char buf[41] = {0};
	char format[23] = {0};

	sprintf(format, "%%%%SHORTSWVER: %%%d[^\r\n]", ARRAY_SIZE(buf));

	ret = nrf_modem_at_scanf("AT%SHORTSWVER",
				 format,
				 buf);

	if (ret != 1) {
		LOG_ERR("Could not get FW version, error: %d", ret);
		return false;
	}
	if (strcmp(should, buf) != 0){
		LOG_ERR("Modem firmware is [%s], but should be [%s]", buf, should);
		return false;
	}
	return true;
}

/**@brief Configures modem to provide LTE link. Blocks until link is
 * successfully established.
 */
static int modem_configure(void)
{
	lte_lc_psm_req(true);

	// enable more detailed error messages
	nrf_modem_at_printf("AT+CMEE=1");
	nrf_modem_at_printf("AT+CNEC=24");

	nrf_modem_gnss_stop();

	int err;

	LOG_INF("LTE Link Connecting...");
	err = lte_lc_init_and_connect();
	if (err) {
		LOG_INF("Failed to establish LTE connection: %d", err);
		return err;
	}
	// force provider to Telenor
	nrf_modem_at_printf("AT+COPS=1,2,\"24201\"");
	LOG_INF("LTE Link Connected!");
	return 0;
}

static void date_time_evt_handler(const struct date_time_evt *evt)
{
	if (evt->type != DATE_TIME_NOT_OBTAINED) {
		k_sem_give(&time_sem);
	}
}

static void gnss_event_handler(int event)
{
	int retval;
	switch (event) {
	case NRF_MODEM_GNSS_EVT_PVT:
		retval = nrf_modem_gnss_read(&pvts[pvts_idx], sizeof(pvts[pvts_idx]), NRF_MODEM_GNSS_DATA_PVT);
		if (retval == 0) {
			LOG_INF("PVT received, flags: 0x%02x, sv:%d%d%d%d%d%d%d%d%d%d%d%d",
				pvts[pvts_idx].flags,
				pvts[pvts_idx].sv[0].flags,
				pvts[pvts_idx].sv[1].flags,
				pvts[pvts_idx].sv[2].flags,
				pvts[pvts_idx].sv[3].flags,
				pvts[pvts_idx].sv[4].flags,
				pvts[pvts_idx].sv[5].flags,
				pvts[pvts_idx].sv[6].flags,
				pvts[pvts_idx].sv[7].flags,
				pvts[pvts_idx].sv[8].flags,
				pvts[pvts_idx].sv[9].flags,
				pvts[pvts_idx].sv[10].flags,
				pvts[pvts_idx].sv[11].flags);
			pvts_idx++;
		}
		break;
	case NRF_MODEM_GNSS_EVT_FIX:
		dk_set_leds(STATE_GOT_FIX_COLOR);
		if (IS_ENABLED(CONFIG_STOP_AFTER_FIRST_FIX)){
			k_sem_give(&measure_sem);
		}
		break;
	default:
		break;
	}
}

static int ttff_test_force_cold_start(void)
{
	int err;
	uint32_t delete_mask;

	LOG_INF("Deleting GNSS data");

	/* Delete everything else except the TCXO offset. */
	delete_mask = NRF_MODEM_GNSS_DELETE_EPHEMERIDES |
		      NRF_MODEM_GNSS_DELETE_ALMANACS |
		      NRF_MODEM_GNSS_DELETE_IONO_CORRECTION_DATA |
		      NRF_MODEM_GNSS_DELETE_LAST_GOOD_FIX |
		      NRF_MODEM_GNSS_DELETE_GPS_TOW |
		      NRF_MODEM_GNSS_DELETE_GPS_WEEK |
		      NRF_MODEM_GNSS_DELETE_UTC_DATA |
		      NRF_MODEM_GNSS_DELETE_GPS_TOW_PRECISION;

	err = nrf_modem_gnss_nv_data_delete(delete_mask);
	if (err) {
		LOG_ERR("Failed to delete GNSS data");
		return -1;
	}

	return 0;
}

int gnss_test(void) {
	int ret;

	LOG_INF("Starting GNSS test");

	if ((ret = lte_lc_func_mode_set(LTE_LC_FUNC_MODE_DEACTIVATE_LTE))) {
		LOG_ERR("Failed to return to power off modem %d", ret);
	}

	if ((ret = lte_lc_func_mode_set(LTE_LC_FUNC_MODE_ACTIVATE_GNSS))) {
		LOG_ERR("Failed to activate GNSS functional mode %d", ret);
		return -1;
	}
	/* Configure GNSS. */
	if ((ret = nrf_modem_gnss_event_handler_set(gnss_event_handler))) {
		LOG_ERR("Failed to set GNSS event handler %d", ret);
		return -1;
	}
	/* Disable all NMEA messages. */
	if ((ret = nrf_modem_gnss_nmea_mask_set(0))) {
		LOG_ERR("Failed to set GNSS NMEA mask %d", ret);
		return -1;
	}

	if ((ret = nrf_modem_gnss_fix_interval_set(1))) {
		LOG_ERR("Failed to set GNSS fix interval %d", ret);
		return -1;
	}

	uint8_t use_case = NRF_MODEM_GNSS_USE_CASE_MULTIPLE_HOT_START;
	if ((ret = nrf_modem_gnss_use_case_set(use_case))) {
		LOG_ERR("Failed to set GNSS use case %d", ret);
		return -1;
	}

	if ((ret = ttff_test_force_cold_start())) {
		LOG_ERR("Failed to reset asssistance data %d", ret);
		return -1;
	}

	if ((ret = nrf_modem_gnss_fix_retry_set(0))) {
		LOG_ERR("Failed to set GNSS timeout %d", ret);
		return -1;
	}

	LOG_INF("Starting GNSS");
	if ((ret = nrf_modem_gnss_start())) {
		LOG_ERR("Failed to start GNSS %d", ret);
		return -1;
	}
	return 0;
}

void configure_wdt(void)
{
	int ret;
	if (!device_is_ready(wdt)) {
		LOG_ERR("Watchdog device not ready");
		return;
	}

	static const struct wdt_timeout_cfg wdt_settings = {
		.window = {
			.min = 0,
			.max = CONFIG_WATCHDOG_TIMEOUT_S * 1000,
		},
		.callback = NULL,
		.flags = WDT_FLAG_RESET_SOC
	};

	ret = wdt_install_timeout(wdt, &wdt_settings);
	if (ret < 0) {
		LOG_ERR("wdt_install_timeout failed: %d", ret);
		return;
	}
	wdt_channel = ret;

	ret = wdt_setup(wdt, WDT_OPT_PAUSE_HALTED_BY_DBG);
	if (ret) {
		LOG_ERR("wdt_setup failed: %d", ret);
	}
}



void main(void)
{
	int ret;
	bool send_connection_data = true;
	struct connection_data_type connection_data = {0};

	/* one-time setup */
	date_time_register_handler(date_time_evt_handler);
	dk_leds_init();
	dk_buttons_init(button_handler);

	/* modem state cleanup */
	nrf_modem_gnss_stop();
	if (lte_lc_func_mode_set(LTE_LC_FUNC_MODE_POWER_OFF) != 0) {
		LOG_ERR("Failed to return to power off modem");
	}
	if (modem_info_init() != 0) {
		LOG_ERR("Failed to initialized modem_info");
	}
	if (!test_modem_fw_ver("nrf9160_1.3.2")) {
		while (true)
		{
			dk_set_leds(STATE_INIT_COLOR);
			k_sleep(K_SECONDS(1));
			dk_set_leds(0);
			k_sleep(K_SECONDS(1));
		}
	}

	configure_wdt();

	while (true) {
		switch (state)
		{
		case STATE_INIT:
			dk_set_leds(STATE_INIT_COLOR);
			/* LTE connect */
			ret = modem_configure();
			if (ret) {
				LOG_INF("Retrying in %d seconds",
					CONFIG_LTE_CONNECT_RETRY_DELAY_S);
				k_sleep(K_SECONDS(CONFIG_LTE_CONNECT_RETRY_DELAY_S));
				continue;
			}

			/* wait for datetime */
			LOG_INF("Waiting for time sync...");
			k_sem_take(&time_sem, K_MINUTES(10));
			LOG_INF("Got time sync!");

			/* MQTT setup */
			ret = _mqtt_client_init(&client);
			if (ret != 0) {
				LOG_ERR("mqtt client_init: %d", ret);
				continue;
			}
			send_connection_data = true;
			set_state(STATE_CONNECT_MQTT);
			break;
		case STATE_CONNECT_MQTT:
			dk_set_leds(STATE_CONNECT_MQTT_COLOR);
			if (mqtt_connect_attempt++ > 0) {
				LOG_INF("Reconnecting in %d seconds...",
					CONFIG_MQTT_RECONNECT_DELAY_S);
				k_sleep(K_SECONDS(CONFIG_MQTT_RECONNECT_DELAY_S));
			}
			ret = _mqtt_establish_connection(&client);
			if (!ret) {
				set_state(STATE_WAIT_FOR_COMMAND);
			}
			break;
		case STATE_WAIT_FOR_COMMAND:
			dk_set_leds(STATE_SEND_RESULTS_COLOR);
			wdt_feed(wdt, wdt_channel);
			if (send_connection_data){
				modem_info_string_get(MODEM_INFO_CELLID,
						      connection_data.cellid,
						      ARRAY_SIZE(connection_data.cellid));
				modem_info_short_get(MODEM_INFO_CUR_BAND, &connection_data.band);
				modem_info_short_get(MODEM_INFO_RSRP, &connection_data.rsrp);
				modem_info_short_get(MODEM_INFO_BATTERY, &connection_data.vbatt);
				ret = _mqtt_data_publish_raw(&client,
					(const uint8_t*) &connection_data,
					sizeof(struct connection_data_type));
				if (!ret) {
					send_connection_data = false;
				}
			}
			while (pvts_send_idx < pvts_idx) {
				ret = _mqtt_data_publish_raw(&client,
					(const uint8_t*) &pvts[pvts_send_idx],
					sizeof(struct nrf_modem_gnss_pvt_data_frame));
				if (ret) {
					break;
				}
				pvts_send_idx++;
			}
			dk_set_leds(STATE_WAIT_FOR_COMMAND_COLOR);
			ret = _mqtt_handle_connection(&client);
			if (ret) {
				set_state(STATE_CONNECT_MQTT);
			}
			break;
		case STATE_MEASURE:
			date_time_now(&connection_data.last_measure_ms);
			dk_set_leds(STATE_MEASURE_COLOR);
			if ((ret = mqtt_disconnect(&client))) {
				LOG_ERR("mqtt_disconnect failed: %d", ret);
			}
			pvts_idx = 0;
			pvts_send_idx = 0;
			if (gnss_test()){
				set_state(STATE_INIT);
			} else {
				set_state(STATE_MEASURE_WAIT);
			}
			break;
		case STATE_MEASURE_WAIT:
			dk_set_leds(STATE_MEASURE_WAIT_COLOR);
			ret = k_sem_take(&measure_sem, K_SECONDS(CONFIG_GNSS_TIMEOUT_S));
			if (ret) {
				LOG_ERR("GNSS timeout reached: %s", (ret==-EAGAIN)?"-EAGAIN":"-EBUSY");
			}
			set_state(STATE_INIT);
			break;
		default:
			break;
		}
	}
}
```

## src/app.h
```c
#pragma once

#if CONFIG_APP_LOW_POWER_MODE
#define STATE_INIT_COLOR		0b000
#define STATE_CONNECT_MQTT_COLOR	0b000
#define STATE_WAIT_FOR_COMMAND_COLOR	0b000
#define STATE_SEND_RESULTS_COLOR	0b000
#define STATE_COUNTDOWN_COLOR		0b000
#define STATE_MEASURE_COLOR		0b000
#define STATE_MEASURE_WAIT_COLOR	0b000
#define STATE_GOT_FIX_COLOR		0b000
#else
#define STATE_INIT_COLOR		0b111 // white
#define STATE_CONNECT_MQTT_COLOR	0b110 // cyan
#define STATE_WAIT_FOR_COMMAND_COLOR	0b010 // green
#define STATE_SEND_RESULTS_COLOR	0b100 // blue
#define STATE_COUNTDOWN_COLOR		0b011 // yellow
#define STATE_MEASURE_COLOR		0b011 // yellow
#define STATE_MEASURE_WAIT_COLOR	0b001 // red
#define STATE_GOT_FIX_COLOR		0b101 // purple
#endif
#include <dk_buttons_and_leds.h>

enum state_type {
	STATE_INIT,
	STATE_CONNECT_MQTT,
	STATE_WAIT_FOR_COMMAND,
	STATE_MEASURE,
	STATE_MEASURE_WAIT,
};

struct connection_data_type
{
	int64_t last_measure_ms;
	uint16_t band;
	uint16_t rsrp;
	char cellid[10];
	uint16_t vbatt;
};


void set_state(enum state_type);
```

## src/mqtt_helpers.c
```c
#include "app.h"
#include "mqtt_helpers.h"

#include <zephyr/random/rand32.h>
#include <zephyr/net/socket.h>
#include <nrf_modem_at.h>
#include <zephyr/logging/log.h>
#include <zephyr/kernel.h>
#include <stdio.h>
#include <date_time.h>

LOG_MODULE_REGISTER(gnss_eval_mqtt, CONFIG_GNSS_EVAL_LOG_LEVEL);

#define IMEI_LEN 15
#define CGSN_RESPONSE_LENGTH (IMEI_LEN + 6 + 1) /* Add 6 for \r\nOK\r\n and 1 for \0 */
#define CLIENT_ID_LEN sizeof("nrf-") + IMEI_LEN
#define WILL_MSG "offline"

/* MQTT Broker details. */
static struct sockaddr_storage broker;

/* File descriptor */
static struct pollfd fds;

static uint8_t status_topic[100];
static uint8_t data_topic[100];
#define COMMAND_TOPIC (CONFIG_MQTT_TOPIC_PREFIX "/" CONFIG_MQTT_COMMAND_TOPIC)

/* Buffers for MQTT client. */
static uint8_t rx_buffer[CONFIG_MQTT_MESSAGE_BUFFER_SIZE];
static uint8_t tx_buffer[CONFIG_MQTT_MESSAGE_BUFFER_SIZE];
static uint8_t payload_buf[CONFIG_MQTT_PAYLOAD_BUFFER_SIZE];

/* Function to get the client id */
static const uint8_t* client_id_get(void)
{
	static uint8_t client_id[MAX(sizeof(CONFIG_MQTT_CLIENT_ID),
				     CLIENT_ID_LEN)];

	if (strlen(CONFIG_MQTT_CLIENT_ID) > 0) {
		snprintf(client_id, sizeof(client_id), "%s",
			 CONFIG_MQTT_CLIENT_ID);
		goto exit;
	}

	char imei_buf[CGSN_RESPONSE_LENGTH + 1];
	int err;

	err = nrf_modem_at_cmd(imei_buf, sizeof(imei_buf), "AT+CGSN");
	if (err) {
		LOG_ERR("Failed to obtain IMEI, error: %d", err);
		goto exit;
	}

	imei_buf[IMEI_LEN] = '\0';

	snprintf(client_id, sizeof(client_id), "nrf-%.*s", IMEI_LEN, imei_buf);

exit:
	LOG_DBG("client_id = %s", client_id);

	return client_id;
}

/**@brief Resolves the configured hostname and
 * initializes the MQTT broker structure
 */
static int mqtt_broker_init(void)
{
	int err;
	struct addrinfo *result;
	struct addrinfo *addr;
	struct addrinfo hints = {
		.ai_family = AF_INET,
		.ai_socktype = SOCK_STREAM
	};

	err = getaddrinfo(CONFIG_MQTT_BROKER_HOSTNAME, NULL, &hints, &result);
	if (err) {
		LOG_ERR("getaddrinfo failed: %d", err);
		return -ECHILD;
	}

	addr = result;

	/* Look for address of the broker. */
	while (addr != NULL) {
		/* IPv4 Address. */
		if (addr->ai_addrlen == sizeof(struct sockaddr_in)) {
			struct sockaddr_in *broker4 =
				((struct sockaddr_in *)&broker);
			char ipv4_addr[NET_IPV4_ADDR_LEN];

			broker4->sin_addr.s_addr =
				((struct sockaddr_in *)addr->ai_addr)
				->sin_addr.s_addr;
			broker4->sin_family = AF_INET;
			broker4->sin_port = htons(CONFIG_MQTT_BROKER_PORT);

			inet_ntop(AF_INET, &broker4->sin_addr.s_addr,
				  ipv4_addr, sizeof(ipv4_addr));
			LOG_INF("IPv4 Address found %s", ipv4_addr);

			break;
		} else {
			LOG_ERR("ai_addrlen = %u should be %u or %u",
				(unsigned int)addr->ai_addrlen,
				(unsigned int)sizeof(struct sockaddr_in),
				(unsigned int)sizeof(struct sockaddr_in6));
		}

		addr = addr->ai_next;
	}

	/* Free the address. */
	freeaddrinfo(result);

	return err;
}

/**@brief Function to read the published payload.
 */
static int get_payload(struct mqtt_client *c, size_t length)
{
	int ret;
	int err = 0;

	/* Return an error if the payload is larger than the payload buffer.
	 * Note: To allow new messages, we have to read the payload before returning.
	 */
	if (length > sizeof(payload_buf)) {
		err = -EMSGSIZE;
	}

	/* Truncate payload until it fits in the payload buffer. */
	while (length > sizeof(payload_buf)) {
		ret = mqtt_read_publish_payload_blocking(
				c, payload_buf, (length - sizeof(payload_buf)));
		if (ret == 0) {
			return -EIO;
		} else if (ret < 0) {
			return ret;
		}

		length -= ret;
	}

	ret = mqtt_readall_publish_payload(c, payload_buf, length);
	if (ret) {
		return ret;
	}

	return err;
}

/**@brief Function to subscribe to the configured topic
 */
static int subscribe(struct mqtt_client *c)
{
	struct mqtt_topic subscribe_topic = {
		.topic = {
			.utf8 = COMMAND_TOPIC,
			.size = strlen(COMMAND_TOPIC)
		},
		.qos = MQTT_QOS_1_AT_LEAST_ONCE
	};

	const struct mqtt_subscription_list subscription_list = {
		.list = &subscribe_topic,
		.list_count = 1,
		.message_id = 1234
	};

	return mqtt_subscribe(c, &subscription_list);
}

/**@brief MQTT client event handler
 */
static void mqtt_evt_handler(struct mqtt_client *const client,
		      const struct mqtt_evt *evt)
{
	int ret;

	switch (evt->type) {
	case MQTT_EVT_CONNACK:
		if (evt->result != 0) {
			LOG_ERR("MQTT connect failed: %d", evt->result);
			break;
		}

		LOG_INF("MQTT client connected");
		subscribe(client);
		ret = _mqtt_status_publish(client, "connected");
		if (ret) {
			LOG_ERR("Publish failed: %d", ret);
		}
		break;
	case MQTT_EVT_DISCONNECT:
		LOG_INF("MQTT client disconnected: %d", evt->result);
		break;
	case MQTT_EVT_PUBLISH: {
		/* Command received */
		const struct mqtt_publish_param *p = &evt->param.publish;

		LOG_INF("MQTT PUBLISH result=%d len=%d",
			evt->result, p->message.payload.len);
		ret = get_payload(client, p->message.payload.len);

		if (p->message.topic.qos == MQTT_QOS_1_AT_LEAST_ONCE) {
			const struct mqtt_puback_param ack = {
				.message_id = p->message_id
			};

			/* Send acknowledgement. */
			mqtt_publish_qos1_ack(client, &ack);
		}

		if (ret >= 0) {
			payload_buf[p->message.payload.len] = 0;
			int64_t unix_time_s = 0;
			ret = sscanf(payload_buf, "%lld", &unix_time_s);
			
			int64_t now = 0; date_time_now(&now);
			if (ret == 1) {
				int64_t delta = (unix_time_s*1000)-now;
				dk_set_leds(STATE_COUNTDOWN_COLOR);
				LOG_INF("will wait %lld ms", delta);
				if (delta > 0){
					k_sleep(K_MSEC(delta));
					set_state(STATE_MEASURE);
				} else {
					LOG_ERR("requested time is in the past");
					ret = _mqtt_status_publish(client, "missed");
					if (ret) {
						LOG_ERR("Publish failed: %d", ret);
					}
				}
			}
		} else if (ret == -EMSGSIZE) {
			LOG_ERR("Received payload (%d bytes) is larger than the payload buffer "
				"size (%d bytes).",
				p->message.payload.len, sizeof(payload_buf));
		} else {
			LOG_ERR("publish_get_payload failed: %d", ret);
			LOG_INF("Disconnecting MQTT client...");

			ret = mqtt_disconnect(client);
			if (ret) {
				LOG_ERR("Could not disconnect: %d", ret);
			}
		}
	} break;

	default:
		LOG_DBG("Unhandled MQTT event type: %d", evt->type);
		break;
	}
}

int _mqtt_client_init(struct mqtt_client *client)
{
	int err;

	static uint8_t will_message_str[10];
	snprintf(will_message_str, sizeof(will_message_str), "%s", WILL_MSG);

	static struct mqtt_topic will_topic = {
		.qos = MQTT_QOS_0_AT_MOST_ONCE,
		.topic.utf8 = status_topic,
	};
	static struct mqtt_utf8 will_message = {
		.utf8 = will_message_str,
	};

	mqtt_client_init(client);

	err = mqtt_broker_init();
	if (err) {
		LOG_ERR("Failed to initialize broker connection");
		return err;
	}

	/* MQTT client configuration */
	client->broker = &broker;
	client->evt_cb = mqtt_evt_handler;
	client->client_id.utf8 = client_id_get();
	client->client_id.size = strlen(client->client_id.utf8);
	client->password = NULL;
	client->user_name = NULL;
	client->protocol_version = MQTT_VERSION_3_1_1;

	/* MQTT buffers configuration */
	client->rx_buf = rx_buffer;
	client->rx_buf_size = sizeof(rx_buffer);
	client->tx_buf = tx_buffer;
	client->tx_buf_size = sizeof(tx_buffer);

	client->will_message = &will_message;
	client->will_topic = &will_topic;

	snprintf(status_topic, sizeof(status_topic), "%s/%s/%s", CONFIG_MQTT_TOPIC_PREFIX, client->client_id.utf8, "status");
	snprintf(data_topic, sizeof(data_topic), "%s/%s/%s", CONFIG_MQTT_TOPIC_PREFIX, client->client_id.utf8, "data");
	will_message.size = strlen(WILL_MSG);
	will_topic.topic.size = strlen(status_topic);

	return err;
}

int _mqtt_establish_connection(struct mqtt_client *client) {
	int ret;

	ret = mqtt_connect(client);
	if (ret != 0) {
		LOG_ERR("mqtt_connect %d", ret);
		return ret;
	}

        if (client->transport.type == MQTT_TRANSPORT_NON_SECURE) {
		fds.fd = client->transport.tcp.sock;
        	fds.events = POLLIN;
	} else {
		LOG_ERR("fds init fail: transport type");
		return ret;
	}

	return EXIT_SUCCESS;
}

int _mqtt_handle_connection(struct mqtt_client *client) {
	int ret;

	ret = poll(&fds, 1, mqtt_keepalive_time_left(client));
	if (ret < 0) {
		LOG_ERR("poll: %d", errno);
		return mqtt_disconnect(client);
	}

	ret = mqtt_live(client);
	if ((ret != 0) && (ret != -EAGAIN)) {
		LOG_ERR("ERROR: mqtt_live: %d", ret);
		return mqtt_disconnect(client);
	}

	if ((fds.revents & POLLIN) == POLLIN) {
		ret = mqtt_input(client);
		if (ret != 0) {
			LOG_ERR("mqtt_input: %d", ret);
			return mqtt_disconnect(client);
		}
	}

	if ((fds.revents & POLLERR) == POLLERR) {
		LOG_ERR("POLLERR");
		return mqtt_disconnect(client);
	}

	if ((fds.revents & POLLNVAL) == POLLNVAL) {
		LOG_ERR("POLLNVAL");
		return mqtt_disconnect(client);
	}
	
	return EXIT_SUCCESS;
}


static int publish(struct mqtt_client *client, const char *data, const char *topic, size_t len) {
	struct mqtt_publish_param param;
	param.message.topic.qos = MQTT_QOS_0_AT_MOST_ONCE;
	param.message.topic.topic.utf8 = topic;
	param.message.topic.topic.size = strlen(param.message.topic.topic.utf8);
	param.message.payload.data = (uint8_t*) data;
	param.message.payload.len = len;
	param.message_id = sys_rand32_get();
	param.dup_flag = 0;
	param.retain_flag = 0;

	return mqtt_publish(client, &param);
}

int _mqtt_data_publish(struct mqtt_client *client, const char *data)
{
	strncpy(payload_buf, data, ARRAY_SIZE(payload_buf));
	return publish(client, payload_buf, data_topic, strlen(payload_buf));
}

int _mqtt_data_publish_raw(struct mqtt_client *client, const char *data, size_t len)
{
	return publish(client, data, data_topic, len);
}

int _mqtt_status_publish(struct mqtt_client *client, const char *data)
{
	strncpy(payload_buf, data, ARRAY_SIZE(payload_buf));
	return publish(client, payload_buf, status_topic, strlen(payload_buf));
}


int _mqtt_command_publish(struct mqtt_client *client, int64_t time_s)
{
	char buf[100] = {0};
	snprintf(buf, ARRAY_SIZE(buf),"%.0f", (double)time_s);
	return publish(client, buf, COMMAND_TOPIC, strlen(buf));
}
```

## src/mqtt_helpers.h
```c
#pragma once

#include <zephyr/net/mqtt.h>

/**@brief Initialize the MQTT client structure
 */
int _mqtt_client_init(struct mqtt_client *);

int _mqtt_establish_connection(struct mqtt_client *);

int _mqtt_handle_connection(struct mqtt_client *);

/**@brief Function to publish data on the configured topic
 */
int _mqtt_data_publish(struct mqtt_client *, const char *);

/**@brief Function to publish status on the configured topic
 */
int _mqtt_status_publish(struct mqtt_client *, const char *);

int _mqtt_data_publish_raw(struct mqtt_client *, const char *, size_t);

int _mqtt_command_publish(struct mqtt_client *, int64_t);
```

## src/tones.c
```c
#include <drivers/pwm.h>
#include <zephyr.h>
#include <device.h>
#include <sys/util.h>

const uint32_t h6 = 506190;
const uint32_t e7 = 379220;
const uint32_t f3 = 5727048;
const uint32_t boop_period = f3;
const uint32_t beep_period = h6;

const struct pwm_dt_spec buzzer = PWM_DT_SPEC_GET(DT_NODELABEL(buzzer_pwm));

void set_tone(uint32_t period) {
        pwm_set_dt(&buzzer, period, period/2);
}

void mute(void) {
        pwm_set_dt(&buzzer, h6, 0);
}

void coin(void) {
        set_tone(h6);
        k_sleep(K_MSEC(75));
        set_tone(e7);
        k_sleep(K_MSEC(225));
        mute();
}

void boop(void) {
        set_tone(boop_period);
        k_sleep(K_MSEC(100));
        mute();
}

void beep(void) {
        set_tone(beep_period);
        k_sleep(K_MSEC(100));
        mute();
}

void gameover(void) {
        const int steps = 4;
        for (int i = 0; i <= steps; ++i) {
                set_tone(beep_period + (boop_period-beep_period)*i/steps);
                k_sleep(K_MSEC(75));
        }
        k_sleep(K_MSEC(50));
        mute();
}
```

## src/tones.h
```c
void coin(void);
void beep(void);
void boop(void);
void gameover(void);
```
